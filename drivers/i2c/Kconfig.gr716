## drivers/i2c/Kconfig.gr716
```kconfig
# gr716 I2C support

# Copyright (c) 2021, Eidel AS
# SPDX-License-Identifier: Apache-2.0

menuconfig I2C_GR716
    bool "gr716 i2c drivers"
    default y
    depends on SOC_SPARC_LEON
```

## dts/bindings/i2c/gaisler,gr716-i2cmst.yaml
```yaml
description: GRLIB I2CMST

compatible: "gaisler,i2cmst"

include: i2c-controller.yaml

properties:
    reg:
      type: array
      required: true
```
