/*
 * Copyright (c) 2019-2020 Cobham Gaisler AB
 *
 * SPDX-License-Identifier: Apache-2.0
 */

/dts-v1/;

#include <gr716a.dtsi>

/ {
	chosen {
		zephyr,console = &uart0;
		zephyr,shell-uart = &uart0;
		zephyr,sram = &dram;
		zephyr,i2c0 = &i2c0;
		zephyr,i2c1 = &i2c1;
	};
};

&uart0 {
	status = "okay";
};

&i2c0 {
	status = "okay";
};
